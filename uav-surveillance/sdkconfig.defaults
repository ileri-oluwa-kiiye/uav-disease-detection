## uav-surveillance/sdkconfig.defaults
```kconfig
# Main task stack
CONFIG_ESP_MAIN_TASK_STACK_SIZE=8192
CONFIG_ESP_SYSTEM_EVENT_TASK_STACK_SIZE=4096
CONFIG_FREERTOS_IDLE_TASK_STACKSIZE=4096
CONFIG_PTHREAD_TASK_STACK_SIZE_DEFAULT=4096

# Camera
CONFIG_CAMERA_TASK_PINNED_TO_CORE_1=y
CONFIG_CAMERA_DMA_BUFFER_SIZE_MAX=32768

# PSRAM
CONFIG_ESP32S3_SPIRAM_SUPPORT=y
CONFIG_SPIRAM=y
CONFIG_SPIRAM_MODE_OCT=y
CONFIG_SPIRAM_SPEED_80M=y
CONFIG_SPIRAM_USE_CAPS_ALLOC=y
CONFIG_SPIRAM_MALLOC_ALWAYSINTERNAL=4096
CONFIG_SPIRAM_TRY_ALLOCATE_WIFI_LWIP=y
CONFIG_ESPTOOLPY_FLASHSIZE_16MB=y

# Networking
CONFIG_LWIP_MAX_SOCKETS=8
CONFIG_HTTPD_MAX_REQ_HDR_LEN=1024
CONFIG_HTTPD_WS_SUPPORT=n

CONFIG_ESP_WIFI_PMF_REQUIRED=n
CONFIG_ESP_WIFI_PMF_ENABLED=n

CONFIG_ESP_PHY_MAX_WIFI_TX_POWER=20
CONFIG_LWIP_TCP_SND_BUF_DEFAULT=16384
CONFIG_LWIP_TCP_WND_DEFAULT=16384
CONFIG_LWIP_TCP_RECVMBOX_SIZE=12

# Watchdog — disable during development
CONFIG_ESP_TASK_WDT=n

CONFIG_I2C_SKIP_LEGACY=y
```
